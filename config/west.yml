## config/west.yml
```yaml
manifest:
  remotes:
    - name: zmkfirmware
      url-base: https://github.com/zmkfirmware
    - name: XixiLee-boom
      url-base: https://github.com/XixiLee-boom
  projects:
    - name: zmk
      remote: XixiLee-boom
      revision: main
      import: app/west.yml
  self:
    path: config
```
